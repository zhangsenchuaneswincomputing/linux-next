## Documentation/devicetree/bindings/dma/eswin,eic7700-dma.yaml
```yaml
# SPDX-License-Identifier: (GPL-2.0-only OR BSD-2-Clause)
%YAML 1.2
---
$id: http://devicetree.org/schemas/dma/eswin,eic7700-dma.yaml#
$schema: http://devicetree.org/meta-schemas/core.yaml#

title: Synopsys DesignWare AXI DMA Controller

maintainers:
  - Xiang Xu <xuxiang@eswincomputing.com>
  - Senchuan Zhang <zhangsenchuan@eswincomputing.com>

description:
  Synopsys DesignWare AXI DMA Controller DT Binding

allOf:
  - $ref: dma-controller.yaml#

properties:
  compatible:
    enum:
      - eswin,eic7700-axi-dma
      - eswin,eic7700-axi-dma-hsp

  reg:
    maxItems: 1

  interrupts:
    maxItems: 1

  resets:
    maxItems: 2

  reset-names:
    items:
      - const: arst
      - const: prst

  '#dma-cells':
    const: 3

  dma-channels:
    minimum: 1
    maximum: 16

  snps,dma-masters:
    description: Number of AXI masters supported by the hardware.
    $ref: /schemas/types.yaml#/definitions/uint32
    enum: [1, 2]

  snps,data-width:
    description: |
      AXI data width supported by hardware.
      (0 - 8bits, 1 - 16bits, 2 - 32bits, ..., 6 - 512bits)
    $ref: /schemas/types.yaml#/definitions/uint32
    enum: [0, 1, 2, 3, 4, 5, 6]

  snps,priority:
    description: Channel priority specifier associated with the DMA channels.
    $ref: /schemas/types.yaml#/definitions/uint32-array
    minItems: 1
    maxItems: 16

  snps,block-size:
    description: Channel block size specifier associated with the DMA channels.
    $ref: /schemas/types.yaml#/definitions/uint32-array
    minItems: 1
    maxItems: 16

  snps,axi-max-burst-len:
    description: |
      Restrict master AXI burst length by value specified in this property.
      If this property is missing the maximum AXI burst length supported by
      DMAC is used.
    $ref: /schemas/types.yaml#/definitions/uint32
    minimum: 1
    maximum: 256

  eswin,syscfg:
    description: Syscfg regs to be used by the controller.
    $ref: /schemas/types.yaml#/definitions/phandle-array

required:
  - compatible
  - reg
  - clocks
  - clock-names
  - interrupts
  - dma-channels
  - snps,dma-masters
  - snps,data-width
  - snps,priority
  - snps,block-size
  - eswin,syscfg

if:
  properties:
    compatible:
      contains:
        enum:
          - eswin,eic7700-axi-dma-hsp

then:
  properties:
    clocks:
      maxItems: 3

    clock-names:
      items:
        - const: core-clk
        - const: cfgr-clk
        - const: axi-clk

else:
  properties:
    clocks:
      maxItems: 2

    clock-names:
      items:
        - const: core-clk
        - const: cfgr-clk

unevaluatedProperties: false

examples:
  - |
    dma{
        #address-cells = <2>;
        #size-cells = <2>;

        dma-controller@518c0000 {
            compatible = "eswin,eic7700-axi-dma-aon";
            reg = <0x0 0x518c0000 0x0 0x10000>;
            interrupt-parent = <&plic>;
            interrupts = <289>;
            clocks = <&clock 614>, <&clock 612>;
            clock-names = "core-clk", "cfgr-clk";
            #dma-cells = <3>;
            dma-channels = <16>;
            snps,dma-masters = <2>;
            snps,priority = <0 1 2 3 4 5 6 7 8 9 10 11 12 13 14 15>;
            snps,data-width = <3>;
            snps,block-size = <0x80000 0x80000 0x80000 0x80000
                0x80000 0x80000 0x80000 0x80000
                0x80000 0x80000 0x80000 0x80000
                0x80000 0x80000 0x80000 0x80000>;
            snps,axi-max-burst-len = <32>;
            resets = <&reset 0x27 (1 << 0)>,
                <&reset 0x27 (1 << 1)>;
            reset-names = "arst", "prst";
            eswin,syscfg = <&sys_con 0x370>;
        };

        dma-controller@50430000 {
            compatible = "eswin,eic7700-axi-dma-hsp";
            reg = <0x0 0x50430000 0x0 0x10000>;
            interrupt-parent = <&plic>;
            interrupts = <57>;
            clocks = <&clock 690>, <&clock 546>, <&clock 545>;
            clock-names = "core-clk", "cfgr-clk", "axi-clk";
            #dma-cells = <3>;
            dma-channels = <12>;
            snps,dma-masters = <1>;
            snps,priority = <0 1 2 3 4 5 6 7 8 9 10 11>;
            snps,data-width = <2>;
            snps,block-size = <0x80000 0x80000 0x80000 0x80000
                0x80000 0x80000 0x80000 0x80000
                0x80000 0x80000 0x80000 0x80000>;
            snps,axi-max-burst-len = <16>;
            resets = <&reset 0x07 (1 << 14)>,
                <&reset 0x07 (1 << 20)>;
            reset-names = "arst", "prst";
            eswin,syscfg = <&sys_con 0x370>;
        };
    };
```

## Documentation/devicetree/bindings/pci/eswin,eic7700-pcie.yaml
```yaml
# SPDX-License-Identifier: (GPL-2.0-only OR BSD-2-Clause)
%YAML 1.2
---
$id: http://devicetree.org/schemas/pci/eswin,eic7700-pcie.yaml#
$schema: http://devicetree.org/meta-schemas/core.yaml#

title: Eswin EIC7700 PCIe host controller

maintainers:
  - Yu Ning <ningyu@eswincomputing.com>
  - Senchuan Zhang <zhangsenchuan@eswincomputing.com>

description:
  The PCIe controller on EIC7700 SoC.

allOf:
  - $ref: /schemas/pci/pci-host-bridge.yaml#

properties:
  compatible:
    const: eswin,eic7700-pcie

  reg:
    maxItems: 3

  reg-names:
    items:
      - const: dbi
      - const: config
      - const: mgmt

  '#interrupt-cells':
    const: 1

  interrupts:
    minItems: 9
    maxItems: 9

  interrupt-names:
    items:
      - const: msi
      - const: inta
      - const: intb
      - const: intc
      - const: intd

  interrupt-controller:
    type: object

  interrupt-map:
    maxItems: 4

  interrupt-map-mask:
    items:
      - const: 0
      - const: 0
      - const: 0
      - const: 7

  clocks:
    maxItems: 4

  clock-names:
    items:
      - const: aclk
      - const: cfg
      - const: cr
      - const: aux

  resets:
    minItems: 1
    maxItems: 3

  reset-names:
    items:
      - const: cfg
      - const: powerup
      - const: pwren

required:
  - compatible
  - reg
  - reg-names
  - interrupts
  - interrupt-names
  - interrupt-map-mask
  - interrupt-map
  - '#interrupt-cells'
  - clocks
  - clock-names
  - resets
  - reset-names

unevaluatedProperties: false

examples:
  - |
    soc {
        #address-cells = <2>;
        #size-cells = <2>;

        pcie: pcie@54000000 {
            compatible = "eswin,eic7700-pcie";
            reg = <0x0 0x54000000 0x0 0x4000000>,
                <0x0 0x40000000 0x0 0x800000>,
                <0x0 0x50000000 0x0 0x100000>;
            reg-names = "dbi", "config", "mgmt";
            ranges = <0x81000000 0x0 0x40800000 0x0 0x40800000 0x0 0x800000>,
                    <0x82000000 0x0 0x41000000 0x0 0x41000000 0x0 0xf000000>,
                    <0xc3000000 0x80 0x00000000 0x80 0x00000000 0x2 0x00000000>;

            bus-range = <0x0 0xff>;
            device_type = "pci";
            num-lanes = <0x4>;

            clocks = <&clock 562>,
                    <&clock 563>,
                    <&clock 564>,
                    <&clock 565>;
            clock-names = "aclk", "cfg", "cr", "aux";
            reset-names = "cfg", "powerup", "pwren";
            resets = <&reset 8 (1 << 0)>,
                    <&reset 8 (1 << 1)>,
                    <&reset 8 (1 << 2)>;

            #address-cells = <3>;
            #size-cells = <2>;
            #interrupt-cells = <1>;
            interrupts = <220>, <179>, <180>, <181>, <182>;
            interrupt-names = "msi", "inta", "intb", "intc", "intd";
            interrupt-parent = <&plic>;
            interrupt-map-mask = <0x0 0x0 0x0 0x7>;
            interrupt-map = <0x0 0x0 0x0 0x1 &plic 179>,
                            <0x0 0x0 0x0 0x2 &plic 180>,
                            <0x0 0x0 0x0 0x3 &plic 181>,
                            <0x0 0x0 0x0 0x4 &plic 182>;
          };
    };
```

## Documentation/devicetree/bindings/usb/eswin,eic7700-usb.yaml
```yaml
# SPDX-License-Identifier: (GPL-2.0-only OR BSD-2-Clause)
%YAML 1.2
---
$id: http://devicetree.org/schemas/usb/eswin,eic7700-usb.yaml#
$schema: http://devicetree.org/meta-schemas/core.yaml#

title: Eswin EIC7700 SoC Usb Controller

maintainers:
  - Wei Yang <yangwei1@eswincomputing.com>
  - Senchuan Zhang <zhangsenchuan@eswincomputing.com>

description:
  The Usb controller on EIC7700 SoC.

properties:
  compatible:
    const: eswin,eic7700-usb

  reg:
    maxItems: 3

  interrupts:
    maxItems: 1

  interrupt-names:
    items:
      - const: peripheral

  clocks:
    maxItems: 3

  clock-names:
    items:
      - const: suspend
      - const: aclk
      - const: cfg_clk

  resets:
    maxItems: 1

  reset-names:
    items:
      - const: vaux

  eswin,hsp-sp-csr:
    description: HSP SP control register.
    $ref: /schemas/types.yaml#/definitions/phandle-array
    items:
      maxItems: 1

required:
  - compatible
  - reg
  - interrupts
  - interrupt-names
  - interrupt-parent
  - clocks
  - clock-names
  - resets
  - reset-names
  - eswin,hsp-sp-csr

additionalProperties: false

examples:
  - |
    soc {
        #address-cells = <2>;
        #size-cells = <2>;

        usb@50480000{
            compatible = "eswin,eic7700-dwc3";
            reg = <0x0 0x50480000 0x0 0x10000>;
            clocks = <&clock 270>,
                    <&clock 545>,
                    <&clock 546>;
            clock-names = "suspend","aclk", "cfg_clk";
            eswin,hsp-sp-csr = <&hsp_sp_csr 0x800 0x808 0x83c 0x840>;
            resets = <&reset 0x07 (1 << 15)>;
            reset-names = "vaux";
            ranges;
            #address-cells = <2>;
            #size-cells = <2>;

            dwc3@50480000 {
                compatible = "snps,dwc3";
                reg = <0x0 0x50480000 0x0 0x10000>;
                #address-cells = <2>;
                #size-cells = <2>;
                interrupt-parent = <&plic>;
                interrupts = <85>;
                interrupt-names = "peripheral";
                dr_mode = "peripheral";
                phy_type = "utmi";
                maximum-speed = "high-speed";
                eswin,hsp-sp-csr = <&hsp_sp_csr 0x1044>;
                snps,dis_enblslpm_quirk;
                snps,dis-u2-freeclk-exists-quirk;
                snps,dis_u2_susphy_quirk;
                snps,dis-del-phy-power-chg-quirk;
                snps,parkmode-disable-ss-quirk;
            };
        };
    };
```
